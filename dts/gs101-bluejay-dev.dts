// SPDX-License-Identifier: GPL-2.0-only
/*
 * Bluejay DEV device tree source
 *
 * Copyright 2020 Google,LLC
 */

/dts-v1/;
/plugin/;

#include "gs101-bluejay.dtsi"
#include "gs101-bluejay-audio.dtsi"
#include "gs101-bluejay-fingerprint.dtsi"
#include "gs101-bluejay-touch-dev.dtsi"
#include "gs101-bluejay-ese.dtsi"
#include "gs101-bluejay-usb.dtsi"
#include "gs101-bluejay-typec-dev.dtsi"

/ {
	board_id = <0x20501>;
	board_rev = <0x010000>;
	fragment@boardbase {
		target-path="/";
		__overlay__ {
			model = "GS101 BLUEJAY DEV based on GS101";
			compatible = "google,GS101 BLUEJAY", "google,GS101";
		};
	};
};
