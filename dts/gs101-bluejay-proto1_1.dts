// SPDX-License-Identifier: GPL-2.0-only
/*
 * Bluejay PROTO1.1 device tree source
 *
 * Copyright 2020 Google,LLC
 */

/dts-v1/;
/plugin/;

#include "gs101-bluejay.dtsi"
#include "gs101-bluejay-audio.dtsi"
#include "gs101-bluejay-fingerprint.dtsi"
#include "gs101-bluejay-touch.dtsi"
#include "gs101-bluejay-ese.dtsi"
#include "gs101-bluejay-usb.dtsi"

/ {
	board_id = <0x20502>;
	board_rev = <0x010100>;
	fragment@boardbase {
		target-path="/";
		__overlay__ {
			model = "GS101 BLUEJAY PROTO 1.1 based on GS101";
			compatible = "google,GS101 BLUEJAY", "google,GS101";
		};
	};
};
