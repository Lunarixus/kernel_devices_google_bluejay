// SPDX-License-Identifier: GPL-2.0-only
/*
 * Battery device tree entries
 *
 * Copyright 2020 Google LLC
 *
 */

maxim,config {
	maxim,default-pack-b-0k {
		maxim,batt-id-kohm = <0>;
		maxim,model-version = <3>;
		maxim,force-reset-model-data;
		maxim,fg-model = /bits/ 16 <
			0xa4d0 0xb810 0xb950 0xb9c0 0xbb30 0xbca0 0xbe80 0xbfa0
			0xc2d0 0xc5b0 0xc950 0xcbe0 0xcfa0 0xd520 0xdaf0 0xdce0
			0x0140 0x1410 0x22f0 0x0d90 0x0db0 0x15e0 0x17e0 0x0dc0
			0x05f0 0x0850 0x09d0 0x04f0 0x07d0 0x06b0 0x05f0 0x05f0
			0x0200 0x0200 0x0200 0x0200 0x0200 0x0200 0x0200 0x0200
			0x0200 0x0200 0x0200 0x0200 0x0200 0x0200 0x0200 0x0200
		>;
		maxim,fg-params = /bits/ 16 <
			/* 0x0036 */	0xf060	/* nIAvgEmpty -> IAvgEmpty */
			/* 0x002a */	0x043c	/* nRelaxCFG -> RelaxCFG */
			/* 0x0028 */	0x260e	/* nLearnCFG -> LearnCFG */
			/* 0x001D */	0x4217	/* Config: */
			/* 0x00BB */	0x0090	/* Config2: OCVQen|DSOCIi */
			/* 0x0013 */	0x5f00	/* nFullSOCThr -> FullSOCThr*/
			/* 0x0035 */	0x0897	/* nFullCapRep */
			/* 0x0018 */	0x0897	/* nDesignCap */
			/* 0x0046 */	0x3200	/* dPacc */
			/* 0x0045 */	0x0225	/* dQacc */
			/* 0x0023 */	0x0897	/* nFullCapNom */
			/* 0x003A */	0xA561	/* V_empty */
			/* 0x0012 */	0x1b00	/* nQRTable00 -> QResidual00 */
			/* 0x0022 */	0x0c80	/* nQRTable10 -> QResidual10 */
			/* 0x0032 */	0x0580	/* nQRTable20 -> QResidual20 */
			/* 0x0042 */	0x0500	/* nQRTable30 -> QResidual30 */
			/* 0x0038 */	0x0700	/* nRcomp0 */
			/* 0x0039 */	0x1002	/* nTempco */
			/* 0x001E */	0x0560	/* ICHGTerm */
			/* 0x002C */	0xED51	/* *TGain */
			/* 0x002D */	0x1EBA	/* *TOFF */
			/* 0x00B9 */	0x0014	/* *TCurve */
			/* 0x002B */	0x3870	/* *nMiscCfg */
			/* 0x0004 */	0x1900	/* AtRate @ 0x04 */
			/* 0x0049 */	0x2241	/* convgcfg */
			/* 0x0029 */	0xc615	/* FilterCFG */
			/* 0x003c */	0x2D00	/* TaskPeriod */
			/* 0x002e */	0x03DE	/* CGain */
		>;
	};
	/* 1_B3_ATL_3113_2_100621_BC59_RC2_1028.txt http://b/204411635#comment1 */
	maxim,atl-pack-b-1k {
		maxim,batt-id-kohm = <1>;
		maxim,model-version = <7>;
		maxim,force-reset-model-data;
		maxim,fg-model = /bits/ 16 <
			0xa4d0 0xb810 0xb950 0xb9c0 0xbb30 0xbca0 0xbe80 0xbfa0
			0xc2d0 0xc5b0 0xc950 0xcbe0 0xcfa0 0xd520 0xdaf0 0xdce0
			0x0140 0x1410 0x22f0 0x0d90 0x0db0 0x15e0 0x17e0 0x0dc0
			0x05f0 0x0850 0x09d0 0x04f0 0x07d0 0x06b0 0x05f0 0x05f0
			0x0200 0x0200 0x0200 0x0200 0x0200 0x0200 0x0200 0x0200
			0x0200 0x0200 0x0200 0x0200 0x0200 0x0200 0x0200 0x0200
		>;
		maxim,fg-params = /bits/ 16 <
			/* 0x0036 */	0xf060	/* nIAvgEmpty -> IAvgEmpty */
			/* 0x002a */	0x043c	/* nRelaxCFG -> RelaxCFG */
			/* 0x0028 */	0x260e	/* nLearnCFG -> LearnCFG */
			/* 0x001D */	0x4217	/* Config: */
			/* 0x00BB */	0x0090	/* Config2: OCVQen|DSOCIi */
			/* 0x0013 */	0x5f00	/* nFullSOCThr -> FullSOCThr*/
			/* 0x0035 */	0x0897	/* nFullCapRep */
			/* 0x0018 */	0x0897	/* nDesignCap */
			/* 0x0046 */	0x3200	/* dPacc */
			/* 0x0045 */	0x0225	/* dQacc */
			/* 0x0023 */	0x0897	/* nFullCapNom */
			/* 0x003A */	0xA561	/* V_empty */
			/* 0x0012 */	0x1b00	/* nQRTable00 -> QResidual00 */
			/* 0x0022 */	0x0c80	/* nQRTable10 -> QResidual10 */
			/* 0x0032 */	0x0580	/* nQRTable20 -> QResidual20 */
			/* 0x0042 */	0x0500	/* nQRTable30 -> QResidual30 */
			/* 0x0038 */	0x0700	/* nRcomp0 */
			/* 0x0039 */	0x1002	/* nTempco */
			/* 0x001E */	0x0560	/* ICHGTerm */
			/* 0x002C */	0xED51	/* *TGain */
			/* 0x002D */	0x1EBA	/* *TOFF */
			/* 0x00B9 */	0x0014	/* *TCurve */
			/* 0x002B */	0x3870	/* *nMiscCfg */
			/* 0x0004 */	0x1900	/* AtRate @ 0x04 */
			/* 0x0049 */	0x2241	/* convgcfg */
			/* 0x0029 */	0xc615	/* FilterCFG */
			/* 0x003c */	0x2D00	/* TaskPeriod */
			/* 0x002e */	0x03DE	/* CGain */
		>;
	};
	/* 3_B3_LSN_3114_1_092821_BC59_RC2_1028.txt http://b/204411635#comment1 */
	maxim,lsn-pack-b-3k {
		maxim,batt-id-kohm = <3>;
		maxim,model-version = <7>;
		maxim,force-reset-model-data;
		maxim,fg-model = /bits/ 16 <
			0xa500 0xb750 0xb8a0 0xbad0 0xbc00 0xbd10 0xbdf0 0xbee0
			0xc080 0xc290 0xc5d0 0xc910 0xcf30 0xd270 0xd5a0 0xdc80
			0x0110 0x1310 0x0c10 0x1400 0x1630 0x1a00 0x1800 0x10e0
			0x0cf0 0x07e0 0x07f0 0x0710 0x06b0 0x06e0 0x0660 0x0660
			0x0200 0x0200 0x0200 0x0200 0x0200 0x0200 0x0200 0x0200
			0x0200 0x0200 0x0200 0x0200 0x0200 0x0200 0x0200 0x0200
		>;
		maxim,fg-params = /bits/ 16 <
			/* 0x0036 */	0xf060	/* nIAvgEmpty -> IAvgEmpty */
			/* 0x002a */	0x043c	/* nRelaxCFG -> RelaxCFG */
			/* 0x0028 */	0x260e	/* nLearnCFG -> LearnCFG */
			/* 0x001D */	0x4217	/* Config: */
			/* 0x00BB */	0x0090	/* Config2: OCVQen|DSOCIi */
			/* 0x0013 */	0x5f00	/* nFullSOCThr -> FullSOCThr*/
			/* 0x0035 */	0x08b1	/* nFullCapRep */
			/* 0x0018 */	0x08b1	/* nDesignCap */
			/* 0x0046 */	0x3200	/* dPacc */
			/* 0x0045 */	0x022c	/* dQacc */
			/* 0x0023 */	0x08b1	/* nFullCapNom */
			/* 0x003A */	0xA561	/* V_empty */
			/* 0x0012 */	0x2500	/* nQRTable00 -> QResidual00 */
			/* 0x0022 */	0x1000	/* nQRTable10 -> QResidual10 */
			/* 0x0032 */	0x0580	/* nQRTable20 -> QResidual20 */
			/* 0x0042 */	0x0480	/* nQRTable30 -> QResidual30 */
			/* 0x0038 */	0x0720	/* nRcomp0 */
			/* 0x0039 */	0x1a02	/* nTempco */
			/* 0x001E */	0x0560	/* ICHGTerm */
			/* 0x002C */	0xED51	/* *TGain */
			/* 0x002D */	0x1EBA	/* *TOFF */
			/* 0x00B9 */	0x0014	/* *TCurve */
			/* 0x002B */	0x3870	/* *nMiscCfg */
			/* 0x0004 */	0x1900	/* AtRate @ 0x04 */
			/* 0x0049 */	0x2241	/* convgcfg */
			/* 0x0029 */	0xc615	/* FilterCFG */
			/* 0x003c */	0x2D00	/* TaskPeriod */
			/* 0x002e */	0x03DE	/* CGain */
		>;
	};

};
